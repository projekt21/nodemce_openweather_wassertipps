const char MAIN_page[] PROGMEM = R"=====(

<!DOCTYPE html>
<html>
<head>
  <meta http-equiv="Content-Type" content="text/html; charset=utf8">
  <meta name="viewport" content="width=device-width, initial-scale=1.0, user-scalable=no">
  <title>Wifi Control</title>
  <style>
    html { font-family: Helvetica; display: inline-block; margin: 0px auto; text-align: center;}
    body {margin-top: 50px;} 
    p, input {font-size: 14px;color: #000;margin-bottom: 10px;}
  </style>
</head>
<body>
  <img src="data:image/png;base64,
iVBORw0KGgoAAAANSUhEUgAAAMgAAABVCAMAAAA7flsxAAAC/VBMVEVHcEz/ZjPsbEvrbkjqbUjr
bUrqbUnqbUnrbEnqbEnrbEnrbEnrbEnrbErqbErqb0rpaELhaUvucUnqbEvrbUnrbErrbUrrbErq
bErwaUv/f3/ubkzrbUrrbEnqaET/YE/qbErqbEnqbUrwcUbra0rrbEnrbUjrbEnnc0XrbEnqbErq
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S0tFRUhGRkdGRkZGRkhGRkhFRUdGRkZFRUhGRkdGRkdGRkdGRkdGRkdGRkhDQ0VFRUdGRkZFRUhF
RUdFRUdFRUhGRkhFRUdFRUdFRUdFRUhGRkhISEhFRUhGRkdFRUdFRUhFRUdGRkhFRUdEREhFRUV/
f39GRkdGRkc/P0xGRkZGRkdFRUdFRUVFRUhGRkhGRkdFRUdFRUhFRUdFRUdGRkdFRUdFRUdFRUdF
RUdHR0dFRUdFRUdGRkdFRUhGRkcAAH9GRkhFRUhGRkdFRUdGRkdEREhISEhFRUdFRUdGRkhGRkZG
RkdFRUhFRUhGRkhGRkdGRkhFRUpHR0dFRUdFRUdKSkpGRkdFRUdGRkZGRkdEREdFRUdFRUdGRkhG
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TQ1LSPp9+Pxt2s+fSn9OTy8ZBRNzn+8fH0/FBBRuiuPAlPpWG161/bSyoLqXUEMCIqJE8J/Fs8jj
eRZ5FjHduVw3x/iP4k+W6I3Hr+I2WQAAAABJRU5ErkJggg=="/>
  <br/><br/>
  <form action="/wifi">
    <label for="ssid">SSID:</label><br>
    <input type="text" id="ssid" name="ssid" value="nirvana.net" maxlength="32"><br>
    <label for="password">Password:</label><br>
    <input type="password" id="password" name="password" value="5882721161769666" maxlength="64"><br>
    <br/>
    <label for="api">OpenWeather API Key:</label><br>
    <input type="api" id="api" name="api" value="56eb1827cf56166afbae2f6e98743d07" maxlength="32"><br>
    <label for="lat">Latitude:</label><br>
    <input type="api" id="lat" name="lat" value="49.879759" maxlength="10"><br>
    <label for="lng">Longitude:</label><br>
    <input type="lng" id="lng" name="lng" value="8.654378" maxlength="10"><br>

    <input type="submit" value="Submit">
  </form>
</body>
</html>

)=====";

// image
// https://javl.github.io/image2cpp/
const unsigned char open_icon [] PROGMEM = {
  // 128x59
  0x00, 0x00, 0x00, 0x00, 0x00, 0x00, 0x00, 0x00, 0x00, 0x00, 0x00, 0x00, 0x00, 0x00, 0x00, 0x00, 
	0x00, 0x00, 0x00, 0x00, 0x00, 0x00, 0x00, 0x00, 0x00, 0x00, 0x00, 0x00, 0x00, 0x00, 0x00, 0x00, 
	0x00, 0x00, 0x00, 0x00, 0x00, 0x00, 0x00, 0x00, 0x00, 0x00, 0x00, 0x00, 0x00, 0x00, 0x00, 0x00, 
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	0x00, 0x00, 0x00, 0x00, 0x00, 0x00, 0x00, 0x00, 0x00, 0x00, 0x00, 0x00, 0x00, 0x00, 0x00, 0x00
};
